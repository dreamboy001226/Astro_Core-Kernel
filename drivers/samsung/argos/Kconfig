## drivers/samsung/argos/Kconfig
```kconfig
config ARGOS
	bool "Throughput monitoring Feature"
	default y
	help
	  This option enables monitoring the data throughput and doing several actions for
	  enhancing the performance such as adjusting the CPU freqency, allocating the tasks
	  to the appropriate CPU and so on
```
